## lab4_2/sdkconfig.defaults
```kconfig
# Bluetooth Configuration
CONFIG_BT_ENABLED=y
CONFIG_BT_BLE_ENABLED=y
CONFIG_BTDM_CTRL_MODE_BLE_ONLY=y
CONFIG_BTDM_CTRL_MODE_BR_EDR_ONLY=n
CONFIG_BTDM_CTRL_MODE_BTDM=n

# Bluedroid Options
CONFIG_BT_BLUEDROID_ENABLED=y
CONFIG_BT_CLASSIC_ENABLED=n
CONFIG_BT_BLE_42_FEATURES_SUPPORTED=y

# BLE GATT
CONFIG_BT_GATTS_ENABLE=y

# Memory
CONFIG_BT_BLE_DYNAMIC_ENV_MEMORY=y

# Device Name
CONFIG_BT_NIMBLE_ENABLED=n
```

## lab4_3/sdkconfig.defaults
```kconfig
# ESP32-C3 Target Configuration
CONFIG_IDF_TARGET="esp32c3"

# Bluetooth Configuration
CONFIG_BT_ENABLED=y
CONFIG_BT_BLUEDROID_ENABLED=y
CONFIG_BT_BLE_ENABLED=y
CONFIG_BT_GATTS_ENABLE=y
CONFIG_BT_GATTC_ENABLE=y

# BLE Features
CONFIG_BT_BLE_42_FEATURES_SUPPORTED=y
# CONFIG_BT_BLE_50_FEATURES_SUPPORTED is not set

# Bluetooth Controller
CONFIG_BT_CONTROLLER_ENABLED=y
CONFIG_BT_CONTROLLER_ONLY=n

# Classic Bluetooth (disable to save memory)
CONFIG_BT_CLASSIC_ENABLED=n
CONFIG_BT_A2DP_ENABLE=n
CONFIG_BT_SPP_ENABLED=n

# BLE HID
CONFIG_BT_NIMBLE_ENABLED=n

# Bluedroid Options
CONFIG_BT_BLUEDROID_PINNED_TO_CORE_0=y
CONFIG_BT_BTU_TASK_STACK_SIZE=4096

# Memory optimization
CONFIG_BT_RELEASE_IRAM=n
```

## lab5_2/sdkconfig.defaults
```kconfig
# ADC Configuration
# Using ADC1 Channel 0 (GPIO1 on ESP32-C3)
# Adjust the GPIO pin based on your ESP32 board

# Enable ADC
CONFIG_ADC_ONESHOT_CTRL_FUNC_IN_IRAM=y
```

## lab5_3/receiver/sdkconfig.defaults
```kconfig
# GPIO interrupt configuration for high-speed detection
CONFIG_GPIO_ESP32_SUPPORT_SWITCH_SLP_PULL=n
```
